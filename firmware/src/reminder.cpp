// ==========================================================================
//  QBIT -- Health reminder system implementation
// ==========================================================================
#include "reminder.h"
#include "app_state.h"
#include "display_helpers.h"
#include "time_manager.h"
#include <Preferences.h>
#include <time.h>
#include <stdio.h>

// ==========================================================================
//  48x48 XBM bitmaps (6 bytes/row × 48 rows = 288 bytes each)
// ==========================================================================

// Water drop icon 48x48
static const uint8_t bmp_water[] PROGMEM = {
    0x00,0x00,0x00,0x00,0x00,0x00, 0x00,0x00,0x00,0x00,0x00,0x00,
    0x00,0x00,0x00,0x00,0x00,0x00, 0x00,0x00,0x00,0x00,0x00,0x00,
    0x00,0x00,0x80,0x01,0x00,0x00, 0x00,0x00,0xC0,0x03,0x00,0x00,
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    0x00,0x00,0x00,0x00,0x00,0x00, 0x00,0x00,0x00,0x00,0x00,0x00,
};

// Plate / food icon 48x48
static const uint8_t bmp_food[] PROGMEM = {
    0x00,0x00,0x00,0x00,0x00,0x00, 0x00,0x00,0x00,0x00,0x00,0x00,
    0x00,0x00,0x00,0x00,0x00,0x00, 0x00,0x00,0x00,0x00,0x00,0x00,
    0x00,0x00,0x00,0x00,0x00,0x00, 0x00,0x00,0x00,0x00,0x00,0x00,
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    0x00,0x00,0x00,0x00,0x00,0x00, 0x00,0x00,0x00,0x00,0x00,0x00,
};

// Pill / medicine icon 48x48
static const uint8_t bmp_pills[] PROGMEM = {
    0x00,0x00,0x00,0x00,0x00,0x00, 0x00,0x00,0x00,0x00,0x00,0x00,
    0x00,0x00,0x00,0x00,0x00,0x00, 0x00,0x00,0x00,0x00,0x00,0x00,
    0x00,0x00,0x00,0x00,0x00,0x00, 0x00,0x00,0x00,0x00,0x00,0x00,
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    0x00,0x00,0x00,0x00,0x00,0x00, 0x00,0x00,0x00,0x00,0x00,0x00,
};

static const uint8_t *_bitmaps[REM_COUNT] = { bmp_water, bmp_food, bmp_pills };

// ==========================================================================
//  Internal config state
// ==========================================================================
static ReminderIntervalCfg _waterCfg  = { true,  120, 8, 22 };
static ReminderFoodCfg     _foodCfg   = { true,  8,0, 13,0, 19,0 };
static ReminderIntervalCfg _pillsCfg  = { false, 480, 8, 22 };

// Last-fired timestamps (millis) to prevent re-firing within cooldown
static unsigned long _lastFiredMs[REM_COUNT] = {0, 0, 0};
#define REMINDER_COOLDOWN_MS  60000u   // 1-minute cooldown after firing

// For food: which meal was last fired (0=breakfast,1=lunch,2=dinner), 0xFF=none
static uint8_t _lastFiredMeal = 0xFF;
// Track the day so we can reset meal-fired state at midnight
static uint8_t _lastFiredDay = 0xFF;

// ==========================================================================
//  NVS load / save
// ==========================================================================
static Preferences _remPrefs;
static bool _remPrefsReady = false;

void reminderLoadSettings() {
    _remPrefs.begin("qbitRem", false);
    _remPrefsReady = true;

    _waterCfg.enabled     = _remPrefs.getBool("wEn",   true);
    _waterCfg.intervalMin = _remPrefs.getUShort("wInt", 120);
    _waterCfg.startHour   = _remPrefs.getUChar("wSH",  8);
    _waterCfg.endHour     = _remPrefs.getUChar("wEH",  22);

    _foodCfg.enabled      = _remPrefs.getBool("fEn",   true);
    _foodCfg.breakfastH   = _remPrefs.getUChar("fBH",  8);
    _foodCfg.breakfastM   = _remPrefs.getUChar("fBM",  0);
    _foodCfg.lunchH       = _remPrefs.getUChar("fLH",  13);
    _foodCfg.lunchM       = _remPrefs.getUChar("fLM",  0);
    _foodCfg.dinnerH      = _remPrefs.getUChar("fDH",  19);
    _foodCfg.dinnerM      = _remPrefs.getUChar("fDM",  0);

    _pillsCfg.enabled     = _remPrefs.getBool("pEn",   false);
    _pillsCfg.intervalMin = _remPrefs.getUShort("pInt", 480);
    _pillsCfg.startHour   = _remPrefs.getUChar("pSH",  8);
    _pillsCfg.endHour     = _remPrefs.getUChar("pEH",  22);
}

void reminderSaveSettings() {
    if (!_remPrefsReady) return;

    _remPrefs.putBool("wEn",   _waterCfg.enabled);
    _remPrefs.putUShort("wInt", _waterCfg.intervalMin);
    _remPrefs.putUChar("wSH",  _waterCfg.startHour);
    _remPrefs.putUChar("wEH",  _waterCfg.endHour);

    _remPrefs.putBool("fEn",   _foodCfg.enabled);
    _remPrefs.putUChar("fBH",  _foodCfg.breakfastH);
    _remPrefs.putUChar("fBM",  _foodCfg.breakfastM);
    _remPrefs.putUChar("fLH",  _foodCfg.lunchH);
    _remPrefs.putUChar("fLM",  _foodCfg.lunchM);
    _remPrefs.putUChar("fDH",  _foodCfg.dinnerH);
    _remPrefs.putUChar("fDM",  _foodCfg.dinnerM);

    _remPrefs.putBool("pEn",   _pillsCfg.enabled);
    _remPrefs.putUShort("pInt", _pillsCfg.intervalMin);
    _remPrefs.putUChar("pSH",  _pillsCfg.startHour);
    _remPrefs.putUChar("pEH",  _pillsCfg.endHour);
}

// ==========================================================================
//  Enable / disable
// ==========================================================================
bool reminderGetEnabled(ReminderType type) {
    switch (type) {
        case REM_WATER: return _waterCfg.enabled;
        case REM_FOOD:  return _foodCfg.enabled;
        case REM_PILLS: return _pillsCfg.enabled;
        default: return false;
    }
}

void reminderSetEnabled(ReminderType type, bool enabled) {
    switch (type) {
        case REM_WATER: _waterCfg.enabled = enabled; break;
        case REM_FOOD:  _foodCfg.enabled  = enabled; break;
        case REM_PILLS: _pillsCfg.enabled = enabled; break;
        default: break;
    }
}

// ==========================================================================
//  Config getters / setters
// ==========================================================================
ReminderIntervalCfg reminderGetWaterCfg() { return _waterCfg; }
void reminderSetWaterCfg(const ReminderIntervalCfg &cfg) { _waterCfg = cfg; }

ReminderFoodCfg reminderGetFoodCfg() { return _foodCfg; }
void reminderSetFoodCfg(const ReminderFoodCfg &cfg) { _foodCfg = cfg; }

ReminderIntervalCfg reminderGetPillsCfg() { return _pillsCfg; }
void reminderSetPillsCfg(const ReminderIntervalCfg &cfg) { _pillsCfg = cfg; }

// ==========================================================================
//  Interval-based check helper (water / pills)
// ==========================================================================
static bool checkInterval(const ReminderIntervalCfg &cfg, uint8_t curH,
                          uint8_t curM, ReminderType type) {
    if (!cfg.enabled) return false;

    // Check hour window
    bool inWindow;
    if (cfg.startHour < cfg.endHour) {
        inWindow = (curH >= cfg.startHour && curH < cfg.endHour);
    } else {
        inWindow = (curH >= cfg.startHour || curH < cfg.endHour);
    }
    if (!inWindow) return false;

    // Check cooldown
    unsigned long now = millis();
    unsigned long cooldown = (unsigned long)cfg.intervalMin * 60000UL;
    if (_lastFiredMs[type] != 0 && (now - _lastFiredMs[type]) < cooldown)
        return false;

    // Check if current minute aligns with interval from start
    uint16_t minsSinceStart;
    if (curH >= cfg.startHour) {
        minsSinceStart = (uint16_t)(curH - cfg.startHour) * 60 + curM;
    } else {
        minsSinceStart = (uint16_t)(24 - cfg.startHour + curH) * 60 + curM;
    }
    return (minsSinceStart % cfg.intervalMin) == 0;
}

// ==========================================================================
//  Food check helper (fixed-time meals)
// ==========================================================================

// Meal labels by sub-index
static const char *_mealLabels[3] = { "Breakfast", "Lunch", "Dinner" };
static uint8_t _activeMealIdx = 0;  // which meal is being shown

static bool checkFood(uint8_t curH, uint8_t curM, uint8_t curDay) {
    if (!_foodCfg.enabled) return false;

    // Reset meal-fired tracking on new day
    if (curDay != _lastFiredDay) {
        _lastFiredMeal = 0xFF;
        _lastFiredDay = curDay;
    }

    // Cooldown
    unsigned long now = millis();
    if (_lastFiredMs[REM_FOOD] != 0 &&
        (now - _lastFiredMs[REM_FOOD]) < REMINDER_COOLDOWN_MS)
        return false;

    uint8_t mealH[3] = { _foodCfg.breakfastH, _foodCfg.lunchH, _foodCfg.dinnerH };
    uint8_t mealM[3] = { _foodCfg.breakfastM, _foodCfg.lunchM, _foodCfg.dinnerM };

    for (uint8_t i = 0; i < 3; i++) {
        if (curH == mealH[i] && curM == mealM[i]) {
            // Only fire once per meal per day
            if (_lastFiredMeal != 0xFF && i <= _lastFiredMeal) continue;
            _activeMealIdx = i;
            return true;
        }
    }
    return false;
}

// ==========================================================================
//  Public: check if any reminder should fire
// ==========================================================================
ReminderType reminderCheck() {
    if (!timeManagerSynced()) return REM_COUNT;

    time_t now = timeManagerNow();
    struct tm ti;
    localtime_r(&now, &ti);
    uint8_t h = (uint8_t)ti.tm_hour;
    uint8_t m = (uint8_t)ti.tm_min;
    uint8_t d = (uint8_t)ti.tm_mday;

    // Check water first, then food, then pills (priority order)
    if (checkInterval(_waterCfg, h, m, REM_WATER)) {
        _lastFiredMs[REM_WATER] = millis();
        return REM_WATER;
    }
    if (checkFood(h, m, d)) {
        _lastFiredMs[REM_FOOD] = millis();
        _lastFiredMeal = _activeMealIdx;
        return REM_FOOD;
    }
    if (checkInterval(_pillsCfg, h, m, REM_PILLS)) {
        _lastFiredMs[REM_PILLS] = millis();
        return REM_PILLS;
    }
    return REM_COUNT;
}

// ==========================================================================
//  Public: get label
// ==========================================================================
const char *reminderGetLabel(ReminderType type) {
    switch (type) {
        case REM_WATER: return "Drink Water";
        case REM_FOOD:  return _mealLabels[_activeMealIdx];
        case REM_PILLS: return "Take Medicine";
        default:        return "";
    }
}

// ==========================================================================
//  Public: draw reminder overlay (48x48 icon + text)
// ==========================================================================
void reminderDraw(ReminderType type) {
    u8g2.clearBuffer();

    // Draw 48x48 bitmap centered horizontally, top area
    const uint8_t *bmp = _bitmaps[type];
    int16_t bx = (128 - 48) / 2;
    u8g2.drawXBM(bx, 0, 48, 48, bmp);

    // Draw label below
    u8g2.setFont(u8g2_font_7x14B_tr);
    const char *label = reminderGetLabel(type);
    uint8_t lw = u8g2.getStrWidth(label);
    u8g2.drawStr((128 - lw) / 2, 62, label);

    rotateBuffer180();
    u8g2.sendBuffer();
}
